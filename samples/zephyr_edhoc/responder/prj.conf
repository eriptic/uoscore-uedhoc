## CMakeLists.txt
```
# SPDX-License-Identifier: Apache-2.0

cmake_minimum_required(VERSION 3.28)

# Use this repository's Zephyr module (zephyr/). prj.conf enables it with
# CONFIG_UEDHOC=y and CONFIG_UOSCORE_UEDHOC_EXTERNAL_DEPS=y, so the library links
# the dependencies listed here, built below from externals/. An application
# that uses Zephyr's zcbor and Mbed TLS modules needs neither of these.
list(APPEND ZEPHYR_EXTRA_MODULES ${CMAKE_CURRENT_LIST_DIR}/../../..)
set(UOSCORE_UEDHOC_DEPENDENCY_TARGETS
  uoscore_uedhoc_vendored_mbedtls
  uoscore_uedhoc_vendored_zcbor
  uoscore_uedhoc_vendored_compact25519
)

find_package(Zephyr REQUIRED HINTS $ENV{ZEPHYR_BASE})
project(responder)

set(REPO_DIR ${CMAKE_CURRENT_LIST_DIR}/../../..)

include(${REPO_DIR}/cmake/uoscore_uedhoc_vendored_deps.cmake)
uoscore_uedhoc_add_zephyr_vendored_deps(
  MBEDTLS_CONFIG_FILE ${REPO_DIR}/test/mbedtls_config_uoscore_uedhoc.h
)

target_sources(app PRIVATE
  src/main.c
  src/_entropy.c
  ${REPO_DIR}/samples/common/sock_ipv6.c
)

target_include_directories(app PRIVATE
  $ENV{ZEPHYR_BASE}/subsys/net/ip
  ${REPO_DIR}/samples/common
  ${REPO_DIR}/test_vectors
)

# main.c uses the PRINT_* macros
target_compile_definitions(app PRIVATE DEBUG_PRINT)
```

## prj.conf
```kconfig
# uoscore-uedhoc, built by this repository's Zephyr module (zephyr/Kconfig).
CONFIG_UOSCORE_UEDHOC_EXTERNAL_DEPS=y
CONFIG_UEDHOC=y
CONFIG_UOSCORE_UEDHOC_COMPACT25519=y
CONFIG_UEDHOC_DEBUG=y

# Generic networking options
CONFIG_NETWORKING=y
CONFIG_NET_UDP=y
CONFIG_NEWLIB_LIBC=y

# Socket
CONFIG_NET_SOCKETS=y
CONFIG_NET_SOCKETS_POSIX_NAMES=y
CONFIG_NET_SOCKETS_POLL_MAX=4

# CoAP
CONFIG_COAP=y
CONFIG_COAP_WELL_KNOWN_BLOCK_WISE=n

# Kernel options
CONFIG_ENTROPY_GENERATOR=y
CONFIG_TEST_RANDOM_GENERATOR=y

# Logging
#CONFIG_PRINTK=y
#CONFIG_NET_LOG=y

# Network Shell
CONFIG_NET_SHELL=y

# Configuration
CONFIG_NET_CONFIG_AUTO_INIT=y
CONFIG_NET_CONFIG_SETTINGS=y
CONFIG_NET_CONFIG_BT_NODE=y
CONFIG_NET_MAX_CONTEXTS=6
CONFIG_NET_PKT_RX_COUNT=10
CONFIG_NET_PKT_TX_COUNT=10
CONFIG_NET_BUF_RX_COUNT=20
CONFIG_NET_BUF_TX_COUNT=20
CONFIG_NET_L2_BT=y

# Enable only one protocol, if you enable both sources
# won't compile.
# IPv6 Support
CONFIG_NET_IPV6=y
#CONFIG_NET_CONFIG_NEED_IPV6=y
CONFIG_NET_CONFIG_MY_IPV6_ADDR="2001:db8::1"
CONFIG_NET_CONFIG_PEER_IPV6_ADDR="2001:db9::2"
CONFIG_NET_IF_UNICAST_IPV6_ADDR_COUNT=3
CONFIG_NET_IF_MCAST_IPV6_ADDR_COUNT=4
CONFIG_NET_MAX_CONTEXTS=6

#IPv4 Support
CONFIG_NET_IPV4=n
#CONFIG_NET_CONFIG_NEED_IPV4=n
#CONFIG_NET_CONFIG_MY_IPV4_ADDR="192.0.2.1"

# RAM configuration
CONFIG_INIT_STACKS=y
CONFIG_MAIN_STACK_SIZE=20000
CONFIG_HEAP_MEM_POOL_SIZE=4096

# Configure Bluetooth LE
#CONFIG_BT=y
#CONFIG_BT_DEBUG_LOG=y
#CONFIG_BT_SMP=y
#CONFIG_BT_PERIPHERAL=y
#CONFIG_BT_CENTRAL=y
#CONFIG_BT_L2CAP_DYNAMIC_CHANNEL=y
#CONFIG_BT_DEVICE_NAME="EdhocResponder"


# Compiler optimization
#CONFIG_COMPILER_OPT="-O3"
#CONFIG_COMPILER_OPT="-Os"
CONFIG_COMPILER_WARNINGS_AS_ERRORS=y

#CONFIG_GPIO=y

# Config Crypto
#CONFIG_TINYCBOR=y
#CONFIG_TINYCRYPT=y
#CONFIG_TINYCRYPT_AES=y
#CONFIG_TINYCRYPT_AES_CCM=y
#CONFIG_TINYCRYPT_SHA256=y
#CONFIG_TINYCRYPT_SHA256_HMAC=y
#CONFIG_WOLFSSL=y
#CONFIG_WOLFSSL_BUILTIN=y

# Compiler optimizations will be set to -Og independently of other options.
#CONFIG_DEBUG=y
#CONFIG_DEBUG_INFO=y
#CONFIG_DEBUG_OPTIMIZATIONS=y
#CONFIG_SYS_PM_DEBUG=y
```

## src/main.c
```c
/*
   Copyright (c) 2021 Fraunhofer AISEC. See the COPYRIGHT
   file at the top-level directory of this distribution.

   Licensed under the Apache License, Version 2.0 <LICENSE-APACHE or
   http://www.apache.org/licenses/LICENSE-2.0> or the MIT license
   <LICENSE-MIT or http://opensource.org/licenses/MIT>, at your
   option. This file may not be copied, modified, or distributed
   except according to those terms.
*/

#include <stdio.h>

#include <zephyr/net/coap.h>

#include "edhoc.h"
#include "sock.h"
#include "edhoc_test_vectors_p256_v16.h"

struct sockaddr_storage client_addr;
socklen_t client_addr_len;

/**
 * @brief	Initializes socket for CoAP server.
 * @param	
 * @retval	error code
 */
static int start_coap_server(int *sockfd)
{
	int err;

	struct sockaddr_in6 servaddr;
	//struct sockaddr_in6 client_addr;
	client_addr_len = sizeof(client_addr);
	memset(&client_addr, 0, sizeof(client_addr));
	const char IPV6_SERVADDR[] = { "2001:db8::1" };
	err = ipv6_sock_init(SOCK_SERVER, IPV6_SERVADDR, &servaddr,
			     sizeof(servaddr), sockfd);
	if (err < 0) {
		printf("error during socket initialization (error code: %d)",
		       err);
		return -1;
	}

	return 0;
}

struct coap_packet cp_req;

enum err ead_process(void *params, struct byte_array *ead13)
{
	/*for this sample we are not using EAD*/
	/*to save RAM we use FEATURES += -DEAD_SIZE=0*/
	return ok;
}

enum err tx(void *sock, struct byte_array *data)
{
	char buffer[MAXLINE];
	struct coap_packet cp_ack;
	int r;
	const uint8_t COAP_CHANGED = 0b01000100;

	r = coap_ack_init(&cp_ack, &cp_req, buffer, sizeof(buffer),
			  COAP_CHANGED);
	if (r < 0) {
		printf("coap_ack_init failed\n");
		return unexpected_result_from_ext_lib;
	}

	r = coap_packet_append_payload_marker(&cp_ack);
	if (r < 0) {
		printf("coap_packet_append_payload_marker failed\n");
		return unexpected_result_from_ext_lib;
	}

	r = coap_packet_append_payload(&cp_ack, data->ptr, data->len);
	if (r < 0) {
		printf("coap_packet_append_payload failed\n");
		return unexpected_result_from_ext_lib;
	}

	PRINT_ARRAY("Sending CoAP message", buffer, cp_ack.offset);

	r = sendto(*((int *)sock), buffer, cp_ack.offset, 0,
		   (struct sockaddr *)&client_addr, client_addr_len);
	if (r < 0) {
		printf("Error: failed to send reply (Code: %d, ErrNo: %d)\n", r,
		       errno);
		return r;
	}

	return ok;
}

enum err rx(void *sock, struct byte_array *data)
{
	int n;
	char buffer[MAXLINE];

	const uint8_t *edhoc_data_p;
	uint16_t edhoc_data_len;

	/* receive */
	client_addr_len = sizeof(client_addr);
	memset(&client_addr, 0, sizeof(client_addr));
	memset(&cp_req, 0, sizeof(cp_req));
	memset(&buffer, 0, sizeof(buffer));

	printf("waiting to receive in rx()\n");
	n = recvfrom(*((int *)sock), (char *)buffer, sizeof(buffer), 0,
		     (struct sockaddr *)&client_addr, &client_addr_len);
	if (n < 0) {
		printf("recv error\n");
	}

	PRINT_ARRAY("received data", buffer, n);

	TRY_EXPECT(coap_packet_parse(&cp_req, buffer, n, NULL, 0), 0);

	edhoc_data_p = coap_packet_get_payload(&cp_req, &edhoc_data_len);

	PRINT_ARRAY("received EDHOC data", edhoc_data_p, edhoc_data_len);

	if (data->len >= edhoc_data_len) {
		memcpy(data->ptr, edhoc_data_p, edhoc_data_len);
		data->len = edhoc_data_len;
	} else {
		printf("insufficient space in buffer");
		return buffer_to_small;
	}

	return ok;
}

int internal_main(void)
{
	int sockfd;
	BYTE_ARRAY_NEW(prk_exporter, 32, 32);
	BYTE_ARRAY_NEW(oscore_master_secret, 16, 16);
	BYTE_ARRAY_NEW(oscore_master_salt, 8, 8);
	BYTE_ARRAY_NEW(PRK_out, 32, 32);
	BYTE_ARRAY_NEW(err_msg, 0, 0);

	/* test vector inputs */
	struct other_party_cred cred_i;
	struct edhoc_responder_context c_r;

	uint8_t TEST_VEC_NUM = 1;
	uint8_t vec_num_i = TEST_VEC_NUM - 1;

	start_coap_server(&sockfd);

	c_r.sock = &sockfd;
	c_r.c_r.ptr = (uint8_t *)test_vectors[vec_num_i].c_r;
	c_r.c_r.len = test_vectors[vec_num_i].c_r_len;
	c_r.suites_r.len = test_vectors[vec_num_i].SUITES_R_len;
	c_r.suites_r.ptr = (uint8_t *)test_vectors[vec_num_i].SUITES_R;
	c_r.ead_2.len = test_vectors[vec_num_i].ead_2_len;
	c_r.ead_2.ptr = (uint8_t *)test_vectors[vec_num_i].ead_2;
	c_r.ead_4.len = test_vectors[vec_num_i].ead_4_len;
	c_r.ead_4.ptr = (uint8_t *)test_vectors[vec_num_i].ead_4;
	c_r.id_cred_r.len = test_vectors[vec_num_i].id_cred_r_len;
	c_r.id_cred_r.ptr = (uint8_t *)test_vectors[vec_num_i].id_cred_r;
	c_r.cred_r.len = test_vectors[vec_num_i].cred_r_len;
	c_r.cred_r.ptr = (uint8_t *)test_vectors[vec_num_i].cred_r;
	c_r.g_y.len = test_vectors[vec_num_i].g_y_raw_len;
	c_r.g_y.ptr = (uint8_t *)test_vectors[vec_num_i].g_y_raw;
	c_r.y.len = test_vectors[vec_num_i].y_raw_len;
	c_r.y.ptr = (uint8_t *)test_vectors[vec_num_i].y_raw;
	c_r.g_r.len = test_vectors[vec_num_i].g_r_raw_len;
	c_r.g_r.ptr = (uint8_t *)test_vectors[vec_num_i].g_r_raw;
	c_r.r.len = test_vectors[vec_num_i].r_raw_len;
	c_r.r.ptr = (uint8_t *)test_vectors[vec_num_i].r_raw;
	c_r.sk_r.len = test_vectors[vec_num_i].sk_r_raw_len;
	c_r.sk_r.ptr = (uint8_t *)test_vectors[vec_num_i].sk_r_raw;
	c_r.pk_r.len = test_vectors[vec_num_i].pk_r_raw_len;
	c_r.pk_r.ptr = (uint8_t *)test_vectors[vec_num_i].pk_r_raw;

	cred_i.id_cred.len = test_vectors[vec_num_i].id_cred_i_len;
	cred_i.id_cred.ptr = (uint8_t *)test_vectors[vec_num_i].id_cred_i;
	cred_i.cred.len = test_vectors[vec_num_i].cred_i_len;
	cred_i.cred.ptr = (uint8_t *)test_vectors[vec_num_i].cred_i;
	cred_i.g.len = test_vectors[vec_num_i].g_i_raw_len;
	cred_i.g.ptr = (uint8_t *)test_vectors[vec_num_i].g_i_raw;
	cred_i.pk.len = test_vectors[vec_num_i].pk_i_raw_len;
	cred_i.pk.ptr = (uint8_t *)test_vectors[vec_num_i].pk_i_raw;
	cred_i.ca.len = test_vectors[vec_num_i].ca_i_len;
	cred_i.ca.ptr = (uint8_t *)test_vectors[vec_num_i].ca_i;
	cred_i.ca_pk.len = test_vectors[vec_num_i].ca_i_pk_len;
	cred_i.ca_pk.ptr = (uint8_t *)test_vectors[vec_num_i].ca_i_pk;

	struct cred_array cred_i_array = { .len = 1, .ptr = &cred_i };
	while (1) {
		edhoc_responder_run(&c_r, &cred_i_array, &err_msg, &PRK_out, tx,
				    rx, ead_process);
		PRINT_ARRAY("PRK_out", PRK_out.ptr, PRK_out.len);

		prk_out2exporter(SHA_256, &PRK_out, &prk_exporter);
		PRINT_ARRAY("prk_exporter", prk_exporter.ptr, prk_exporter.len);

		edhoc_exporter(SHA_256, OSCORE_MASTER_SECRET, &prk_exporter,
			       &oscore_master_secret);
		PRINT_ARRAY("OSCORE Master Secret", oscore_master_secret.ptr,
			    oscore_master_secret.len);

		edhoc_exporter(SHA_256, OSCORE_MASTER_SALT, &prk_exporter,
			       &oscore_master_salt);
		PRINT_ARRAY("OSCORE Master Salt", oscore_master_salt.ptr,
			    oscore_master_salt.len);
	}

	close(sockfd);
	return 0;
}

void main(void)
{
	int r = internal_main();
	if (r != 0) {
		printf("error during initiator run. Error code: %d\n", r);
	}
}
```

## src/_entropy.c
```c
#include <stddef.h>
#include <stdint.h>

/* IMPORTANT! PROVIDE HERE A REAL ENTROPY! */
int mbedtls_hardware_poll(void *data, unsigned char *output, size_t len,
			  size_t *olen)
{
	(void)data;

	if (output == NULL) {
		return -1;
	}

	if (olen == NULL) {
		return -1;
	}

	if (len == 0) {
		return -1;
	}

	/*We don't get real random numbers*/
	for (size_t i = 0; i < len; i++) {
		output[i] = i;
	}

	*olen = len;

	return 0;
}
```

## src/credentials.h
```c
/*
   Copyright (c) 2021 Fraunhofer AISEC. See the COPYRIGHT
   file at the top-level directory of this distribution.

   Licensed under the Apache License, Version 2.0 <LICENSE-APACHE or
   http://www.apache.org/licenses/LICENSE-2.0> or the MIT license
   <LICENSE-MIT or http://opensource.org/licenses/MIT>, at your
   option. This file may not be copied, modified, or distributed
   except according to those terms.
*/
#ifndef CREDENTIALS
#define CREDENTIALS

#include <stdint.h>

#include "credentials_select.h"

#if defined INITIATOR_TEST_1 || defined INITIATOR_TEST_2 ||                    \
	defined INITIATOR_TEST_3 || defined INITIATOR_TEST_4 ||                \
	defined INITIATOR_TEST_5
extern enum method_type METHOD_TYPE;
extern uint8_t CORR;

extern uint8_t SUITES_I[];
extern uint32_t SUITES_I_LEN;

extern uint8_t G_X[];
extern uint32_t G_X_LEN;

extern uint8_t X[];
extern uint32_t X_LEN;

extern uint8_t C_I[];
extern uint32_t C_I_LEN;

extern uint8_t AD_1[];
extern uint32_t AD_1_LEN;

extern uint8_t AD_3[];
extern uint32_t AD_3_LEN;

extern uint8_t I[];
extern uint32_t I_LEN;

extern uint8_t G_I[];
extern uint32_t G_I_LEN;

extern uint8_t ID_CRED_I[];
extern uint32_t ID_CRED_I_LEN;

extern uint8_t CRED_I[];
extern uint32_t CRED_I_LEN;

extern uint8_t SK_I[];
extern uint32_t SK_I_LEN;

extern uint8_t PK_I[];
extern uint32_t PK_I_LEN;

/*other party credentials*/
extern uint8_t ID_CRED_R[];
extern uint32_t ID_CRED_R_LEN;

extern uint8_t CRED_R[];
extern uint32_t CRED_R_LEN;

extern uint8_t PK_R[];
extern uint32_t PK_R_LEN;

extern uint8_t G_R[];
extern uint32_t G_R_LEN;

extern uint8_t CA[];
extern uint32_t CA_LEN;

extern uint8_t CA_PK[];
extern uint32_t CA_PK_LEN;
#endif

#if defined RESPONDER_TEST_1 || defined RESPONDER_TEST_2 ||                    \
	defined RESPONDER_TEST_3 || defined RESPONDER_TEST_4 ||                \
	defined RESPONDER_TEST_5
extern uint8_t SUITES_R[];
extern uint32_t SUITES_R_LEN;

extern uint8_t G_Y[];
extern uint32_t G_Y_LEN;

extern uint8_t Y[];
extern uint32_t Y_LEN;

extern uint8_t C_R[];
extern uint32_t C_R_LEN;

extern uint8_t AD_2[];
extern uint32_t AD_2_LEN;

extern uint8_t ID_CRED_R[];
extern uint32_t ID_CRED_R_LEN;

extern uint8_t CRED_R[];
extern uint32_t CRED_R_LEN;

extern uint8_t SK_R[];
extern uint32_t SK_R_LEN;

extern uint8_t PK_R[];
extern uint32_t PK_R_LEN;

extern uint8_t R[];
extern uint32_t R_LEN;

extern uint8_t G_R[];
extern uint32_t G_R_LEN;

/*other party credentials*/
extern uint8_t ID_CRED_I[];
extern uint32_t ID_CRED_I_LEN;

extern uint8_t CRED_I[];
extern uint32_t CRED_I_LEN;

extern uint8_t PK_I[];
extern uint32_t PK_I_LEN;

extern uint8_t G_I[];
extern uint32_t G_I_LEN;

extern uint8_t CA[];
extern uint32_t CA_LEN;

extern uint8_t CA_PK[];
extern uint32_t CA_PK_LEN;
#endif

#if (defined INITIATOR_TEST_1) || (defined RESPONDER_TEST_1) ||                \
	(defined INITIATOR_TEST_2) || (defined RESPONDER_TEST_2) ||            \
	(defined INITIATOR_TEST_3) || (defined RESPONDER_TEST_3) ||            \
	(defined INITIATOR_TEST_4) || (defined RESPONDER_TEST_4) ||            \
	(defined INITIATOR_TEST_5) || (defined RESPONDER_TEST_5)

extern uint8_t MSG_1[];
extern uint32_t MSG_1_LEN;

extern uint8_t MSG_2[];
extern uint32_t MSG_2_LEN;

extern uint8_t MSG_3[];
extern uint32_t MSG_3_LEN;
#endif

#endif /* CREDENTIALS */
```

## src/credentials_select.h
```c
/*
   Copyright (c) 2021 Fraunhofer AISEC. See the COPYRIGHT
   file at the top-level directory of this distribution.

   Licensed under the Apache License, Version 2.0 <LICENSE-APACHE or
   http://www.apache.org/licenses/LICENSE-2.0> or the MIT license
   <LICENSE-MIT or http://opensource.org/licenses/MIT>, at your
   option. This file may not be copied, modified, or distributed
   except according to those terms.
*/
#ifndef CREDENTIALS_SELECT_H_
#define CREDENTIALS_SELECT_H_

/*Test vector description*/
/*

Macro            | mode                          | RPK/Cert | suite | Ref [1]
INITIATOR_TEST_1 | INITIATOR_SK_RESPONDER_SK     | RPK x5t  | 0     | 1-290
RESPONDER_TEST_1 | INITIATOR_SK_RESPONDER_SK     | RPK x5t  | 0     | 1-290
INITIATOR_TEST_2 | INITIATOR_SDHK_RESPONDER_SDHK | RPK kid  | 0     | 292-540
RESPONDER_TEST_2 | INITIATOR_SDHK_RESPONDER_SDHK | RPK kid  | 0     | 292-540
INITIATOR_TEST_3 | INITIATOR_SK_RESPONDER_SK     | x5chain  | 0     | non
RESPONDER_TEST_3 | INITIATOR_SK_RESPONDER_SK     | x5chain  | 0     | non
INITIATOR_TEST_4 | INITIATOR_SDHK_RESPONDER_SDHK | x5chain  | 0     | non
RESPONDER_TEST_5 | INITIATOR_SDHK_RESPONDER_SDHK | x5chain  | 0     | non


[1]: https://github.com/EricssonResearch/EDHOC/blob/master/Test%20Vectors/vectors.txt

*/

//#define INITIATOR_TEST_1
#define RESPONDER_TEST_1

//#define INITIATOR_TEST_2
//#define RESPONDER_TEST_2

//#define INITIATOR_TEST_3
//#define RESPONDER_TEST_3

//#define INITIATOR_TEST_4
//#define RESPONDER_TEST_4

#endif /* CREDENTIALS_SELECT_H_ */
```
